## sdkconfig.defaults.idf6_lowram
```kconfig
# ESP-IDF 6 low-RAM overlay. This file is intentionally appended after the
# legacy generated defaults so these choices override the IDF 5-era baseline.

# Compiler/libc
CONFIG_COMPILER_OPTIMIZATION_SIZE=y
# CONFIG_COMPILER_OPTIMIZATION_PERF is not set
# CONFIG_COMPILER_OPTIMIZATION_DEBUG is not set
# CONFIG_COMPILER_OPTIMIZATION_NONE is not set
# CONFIG_LIBC_NEWLIB is not set
CONFIG_LIBC_PICOLIBC=y
# CONFIG_LIBC_PICOLIBC_NEWLIB_COMPATIBILITY is not set
# CONFIG_LIBC_MISC_IN_IRAM is not set
# CONFIG_LIBC_LOCKS_PLACE_IN_IRAM is not set

# Move hot-path system code out of the shared IRAM/DRAM window where possible.
# CONFIG_FREERTOS_IN_IRAM is not set
CONFIG_FREERTOS_PLACE_FUNCTIONS_INTO_FLASH=y
CONFIG_FREERTOS_PLACE_SNAPSHOT_FUNS_INTO_FLASH=y
CONFIG_HEAP_PLACE_FUNCTION_INTO_FLASH=y

# Production memory cleanup
# IDF 6.0.1 keeps ESP_GDBSTUB_ENABLED hidden-on; leaving runtime enabled avoids
# an upstream compile bug when task support is disabled, while avoiding the
# RAM-heavy task snapshot array.
CONFIG_ESP_SYSTEM_GDBSTUB_RUNTIME=y
# CONFIG_ESP_GDBSTUB_SUPPORT_TASKS is not set
# CONFIG_FREERTOS_USE_TRACE_FACILITY is not set
# CONFIG_FREERTOS_USE_STATS_FORMATTING_FUNCTIONS is not set
# CONFIG_FREERTOS_GENERATE_RUN_TIME_STATS is not set
# CONFIG_LOG_DYNAMIC_LEVEL_CONTROL is not set
CONFIG_LOG_TAG_LEVEL_IMPL_NONE=y
# CONFIG_LOG_TAG_LEVEL_IMPL_CACHE_AND_LINKED_LIST is not set
# CONFIG_LOG_IN_IRAM is not set
# CONFIG_UNITY_ENABLE_FLOAT is not set
# CONFIG_UNITY_ENABLE_DOUBLE is not set
# CONFIG_UNITY_ENABLE_IDF_TEST_RUNNER is not set

# WiFi/crypto footprint. VESC Express uses raw VESC TCP/UDP paths by default.
# CONFIG_ESP_WIFI_ENTERPRISE_SUPPORT is not set
# CONFIG_ESP_WIFI_ENABLE_WPA3_SAE is not set
# CONFIG_ESP_WIFI_ENABLE_SAE_H2E is not set
# CONFIG_ESP_WIFI_ENABLE_SAE_PK is not set
# CONFIG_ESP_WIFI_SOFTAP_SAE_SUPPORT is not set
# CONFIG_ESP_WIFI_WPA3_COMPATIBLE_SUPPORT is not set
# CONFIG_ESP_WIFI_FTM_ENABLE is not set
# CONFIG_ESP_WIFI_FTM_INITIATOR_SUPPORT is not set
# CONFIG_ESP_WIFI_FTM_RESPONDER_SUPPORT is not set
CONFIG_MBEDTLS_TLS_DISABLED=y
# CONFIG_MBEDTLS_TLS_SERVER_AND_CLIENT is not set
# CONFIG_MBEDTLS_TLS_SERVER_ONLY is not set
# CONFIG_MBEDTLS_TLS_CLIENT_ONLY is not set
# CONFIG_MBEDTLS_TLS_SERVER is not set
# CONFIG_MBEDTLS_TLS_CLIENT is not set
# CONFIG_MBEDTLS_CERTIFICATE_BUNDLE is not set
# CONFIG_MBEDTLS_CERTIFICATE_BUNDLE_DEFAULT_FULL is not set

# BLE default: NimBLE peripheral/server profile.
CONFIG_BT_ENABLED=y
# CONFIG_BT_BLUEDROID_ENABLED is not set
CONFIG_BT_NIMBLE_ENABLED=y
CONFIG_BT_NIMBLE_ROLE_PERIPHERAL=y
CONFIG_BT_NIMBLE_ROLE_BROADCASTER=y
# CONFIG_BT_NIMBLE_ROLE_CENTRAL is not set
# CONFIG_BT_NIMBLE_ROLE_OBSERVER is not set
CONFIG_BT_NIMBLE_GATT_SERVER=y
CONFIG_BT_NIMBLE_GAP_SERVICE=y
CONFIG_BT_NIMBLE_MAX_CONNECTIONS=1
CONFIG_BT_NIMBLE_MAX_CCCDS=1
CONFIG_BT_NIMBLE_MAX_BONDS=2
CONFIG_BT_NIMBLE_WHITELIST_SIZE=4
# CONFIG_BT_NIMBLE_ENABLE_CONN_REATTEMPT is not set
CONFIG_BT_NIMBLE_HOST_TASK_STACK_SIZE=3152
CONFIG_BT_ALARM_MAX_NUM=15

# Keep encrypted BLE mode available; disable only if this build is open BLE only.
CONFIG_BT_NIMBLE_SECURITY_ENABLE=y
CONFIG_BT_NIMBLE_SM_LEGACY=y
CONFIG_BT_NIMBLE_SM_SC=y
CONFIG_BT_NIMBLE_LL_CFG_FEAT_LE_ENCRYPTION=y

# VESC BLE uses one custom UART-style GATT service. Keep the tunables explicit
# so optional features can be enabled by flipping one line in this overlay.
CONFIG_BT_NIMBLE_ATT_PREFERRED_MTU=256
CONFIG_BT_NIMBLE_ATT_MAX_PREP_ENTRIES=15
CONFIG_BT_NIMBLE_GATT_MAX_PROCS=2
CONFIG_BT_NIMBLE_MSYS_1_BLOCK_COUNT=6
CONFIG_BT_NIMBLE_MSYS_2_BLOCK_COUNT=12
CONFIG_BT_NIMBLE_TRANSPORT_ACL_FROM_LL_COUNT=12
CONFIG_BT_NIMBLE_TRANSPORT_EVT_COUNT=15
CONFIG_BT_NIMBLE_TRANSPORT_EVT_DISCARD_COUNT=4

# Optional NimBLE features disabled for the low-RAM profile.
# CONFIG_BT_NIMBLE_50_FEATURE_SUPPORT is not set
# CONFIG_BT_NIMBLE_LL_CFG_FEAT_LE_2M_PHY is not set
# CONFIG_BT_NIMBLE_LL_CFG_FEAT_LE_CODED_PHY is not set
# CONFIG_BT_NIMBLE_EXT_ADV is not set
# CONFIG_BT_NIMBLE_EXT_SCAN is not set
# CONFIG_BT_NIMBLE_ISO is not set
# CONFIG_BT_NIMBLE_DTM_MODE_TEST is not set
# CONFIG_BT_NIMBLE_EXTRA_ADV_FIELDS is not set
# CONFIG_BT_NIMBLE_PRINT_ERR_NAME is not set
CONFIG_BT_NIMBLE_LOG_LEVEL_NONE=y
# CONFIG_BT_NIMBLE_LOG_LEVEL_ERROR is not set
# CONFIG_BT_NIMBLE_LOG_LEVEL_WARNING is not set
# CONFIG_BT_NIMBLE_LOG_LEVEL_INFO is not set
# CONFIG_BT_NIMBLE_LOG_LEVEL_DEBUG is not set
CONFIG_BT_NIMBLE_LOG_LEVEL=4

# Optional standard NimBLE services. VESC Tool uses the custom service above.
# CONFIG_BT_NIMBLE_PROX_SERVICE is not set
# CONFIG_BT_NIMBLE_ANS_SERVICE is not set
# CONFIG_BT_NIMBLE_CTS_SERVICE is not set
# CONFIG_BT_NIMBLE_HTP_SERVICE is not set
# CONFIG_BT_NIMBLE_IPSS_SERVICE is not set
# CONFIG_BT_NIMBLE_TPS_SERVICE is not set
# CONFIG_BT_NIMBLE_IAS_SERVICE is not set
# CONFIG_BT_NIMBLE_LLS_SERVICE is not set
# Keep SPS enabled: ESP-IDF 6.0.1's NimBLE host references ble_svc_sps_reset
# from ble_gatts_reset even when VESC uses its own custom UART-style service.
CONFIG_BT_NIMBLE_SPS_SERVICE=y
# CONFIG_BT_NIMBLE_HR_SERVICE is not set
# CONFIG_BT_NIMBLE_HID_SERVICE is not set
# CONFIG_BT_NIMBLE_BAS_SERVICE is not set
# CONFIG_BT_NIMBLE_DIS_SERVICE is not set

# Controller scan/duplicate-filter memory is not needed by the BLE peripheral.
CONFIG_BT_CTRL_ADV_DUP_FILT_MAX=1
# CONFIG_BT_CTRL_BLE_SCAN_DUPL is not set

# Conservative network limits for VESC local TCP + optional hub connection.
CONFIG_LWIP_MAX_ACTIVE_TCP=4
CONFIG_LWIP_MAX_LISTENING_TCP=2
CONFIG_LWIP_DHCPS_MAX_STATION_NUM=4
CONFIG_LWIP_MAX_RAW_PCBS=4
CONFIG_LWIP_DNS_MAX_SERVERS=2
```

## sdkconfig.defaults.idf6_lowram.esp32c3
```kconfig
# ESP32-C3 needs one controller activity for connectable advertising and
# another for the connection. One activity can keep NimBLE from appearing.
CONFIG_BT_CTRL_BLE_MAX_ACT=2
CONFIG_BT_CTRL_BLE_MAX_ACT_EFF=2
```

## sdkconfig.defaults.idf6_lowram.esp32s3
```kconfig
# S3 controller/NimBLE trim.
CONFIG_BT_CTRL_BLE_MAX_ACT=1
CONFIG_BT_CTRL_BLE_MAX_ACT_EFF=1
```

## sdkconfig.defaults.idf6_lowram.nowireless
```kconfig
# No-wireless overlay for HW_IS_SLAVE class builds.
# CONFIG_BT_ENABLED is not set
# CONFIG_BT_BLUEDROID_ENABLED is not set
# CONFIG_BT_NIMBLE_ENABLED is not set
# CONFIG_ESP_WIFI_ENABLED is not set
# CONFIG_ESP32_WIFI_ENABLED is not set
```
